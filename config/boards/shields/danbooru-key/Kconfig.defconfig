## config/boards/shields/danbooru-key/Kconfig.defconfig
```kconfig
if SHIELD_DANBOORU_KEY

config ZMK_KEYBOARD_NAME
  default "danbooru_key"

endif

if ZMK_BACKLIGHT

config PWM
  default y

config LED_PWM
  default y

endif # ZMK_BACKLIGHT
```
